// SPDX-License-Identifier: (GPL-2.0-or-later OR MIT)
/*
 * A20: enlarge the default CMA pool from 96 MB to 224 MB (VE codecs + GPU + display) on 2 GiB boards.
 * alloc-ranges stays <0x40000000 0x10000000>: the Video Engine only reaches the first 256 MB of DRAM.
 * Never use the cma= kernel argument instead (it would move the pool out of the VE window).
 * The kernel image occupies 0x40008000-0x417fffff, so 224 MB (0x42000000-0x4fffffff) is the
 * largest pool that fits the VE window with a little headroom.
 */
/dts-v1/;
/plugin/;

/ {
	compatible = "allwinner,sun7i-a20";

	fragment@0 {
		target-path = "/reserved-memory/default-pool";
		__overlay__ {
			size = <0x0e000000>;
		};
	};
};
